#include <esp_sleep.h>
#include <Wire.h>     
#include <Adafruit_GFX.h>
#include <Adafruit_SSD1306.h>
#include <SPI.h>
#include <LoRa.h>

#define OLED_SDA 4
#define OLED_SCL 15 
#define OLED_RST 16
#define SCREEN_WIDTH 128
#define SCREEN_HEIGHT 64

//configurações LoRa
#define LORA_SS 18
#define LORA_RST 14
#define LORA_DIO0 26
#define LORA_BAND 915E6  //banda de 915 MHz

Adafruit_SSD1306 display(SCREEN_WIDTH, SCREEN_HEIGHT, &Wire, OLED_RST);

//bitmap 64x64
const unsigned char logoLab_bitmap[] PROGMEM = { 0xff, 0xff, 0xff, 0xc0, 0x03, 0xff, 0xff, 0xff, 0xff, 0xff, 0xfe, 0x00, 0x00, 0x7f, 0xff, 0xff, 
	0xff, 0xff, 0xf0, 0x3f, 0xfc, 0x0f, 0xff, 0xff, 0xff, 0xff, 0xc3, 0xff, 0xff, 0xc3, 0xff, 0xff, 
	0xff, 0xff, 0x0f, 0xff, 0xff, 0xf0, 0xff, 0xff, 0xff, 0xfc, 0x3f, 0xff, 0xff, 0xfc, 0x3f, 0xff, 
	0xff, 0xf8, 0xff, 0xff, 0xff, 0xff, 0x1f, 0xff, 0xff, 0xf1, 0xff, 0xff, 0xff, 0xff, 0x8f, 0xff, 
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	0xff, 0xff, 0xfc, 0x00, 0x00, 0x3f, 0xff, 0xff, 0xff, 0xff, 0xff, 0xc0, 0x03, 0xff, 0xff, 0xff
};

//tamanho do bloco para o LoRa (aprox. 240 bytes por pacote)
const int CHUNK_SIZE = 240;
const int IMAGE_SIZE = sizeof(logoLab_bitmap);
int totalChunks = (IMAGE_SIZE + CHUNK_SIZE - 1) / CHUNK_SIZE;  //pacotes que são necessários

void setup() {
  Serial.begin(115200);
  
  //inicialização display OLED
  Wire.begin(OLED_SDA, OLED_SCL);
  if (!display.begin(SSD1306_SWITCHCAPVCC, 0x3C, true, false)) {
    Serial.println(F("Falha na inicialização do display SSD1306"));
    for(;;);
  }

  display.clearDisplay();
  display.drawBitmap(0, 0, logoLab_bitmap, 64, 64, WHITE);
  display.display();
  delay(2000);

  //configuração LoRa
  LoRa.setPins(LORA_SS, LORA_RST, LORA_DIO0);
  if (!LoRa.begin(LORA_BAND)) {
    Serial.println("Erro ao inicializar o módulo LoRa");
    while (1);
  }
  Serial.println("LoRa inicializado com sucesso");

  //envio da imagem
  for (int i = 0; i < totalChunks; i++) {
    sendChunk(i);
    delay(500);  //intervalo entre pacotes
  }
}

void sendChunk(int chunkIndex) {
  int startByte = chunkIndex * CHUNK_SIZE;
  int endByte = min(startByte + CHUNK_SIZE, IMAGE_SIZE);

  //inicia o pacote com o índice
  LoRa.beginPacket();
  LoRa.write(chunkIndex);

  //envia o bloco atual
  for (int i = startByte; i < endByte; i++) {
    LoRa.write(pgm_read_byte_near(logoLab_bitmap + i));
  }

  LoRa.endPacket();
  Serial.print("Pacote enviado: ");
  Serial.println(chunkIndex);
}

void loop() {
  //entra em modo sleep para poupar energia
  esp_deep_sleep(10 * 1000000);  //sleep por 10 segundos
}
